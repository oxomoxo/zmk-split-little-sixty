## boards/shields/split_little_60/Kconfig.defconfig
```kconfig
# Copyright (c) 2024 Lorenzo Pastrana
# SPDX-License-Identifier: MIT

SOC_SERIES_NRF52X=y
SOC_NRF52840_QIAA=y

if SHIELD_SPLIT_LITTLE_60_DONGLE

config ZMK_SPLIT_ROLE_CENTRAL
    default y

config ZMK_KEYBOARD_NAME
    default "Split Little 60"

config ZMK_SPLIT
    default y

config ZMK_USB
    default y

endif

if SHIELD_SPLIT_LITTLE_60_LEFTC

config ZMK_SPLIT_ROLE_CENTRAL
    default y

config ZMK_KEYBOARD_NAME
    default "Split Little 60"

config ZMK_SPLIT
    default y

config ZMK_BLE
    default y

endif

if SHIELD_SPLIT_LITTLE_60_LEFT

config ZMK_KEYBOARD_NAME
    default "Split Little 60"

config ZMK_SPLIT
    default y

config ZMK_BLE
    default y

endif

if SHIELD_SPLIT_LITTLE_60_LEFT || SHIELD_SPLIT_LITTLE_60_LEFTC

config ZMK_DISPLAY
	default y

if ZMK_DISPLAY

config SERIAL
	default n
config CONSOLE
	default n
config UART_CONSOLE
	default n

# enable pinctrl
config PINCTRL
	default y

# enable GPIO
config GPIO
	default y

# Enable I2C
config I2C
	default y
config I2C_NRFX
	default y

# enable display drivers
ZMK_DISPLAY_WORK_QUEUE_DEDICATED=y
ZMK_DISPLAY_DEDICATED_THREAD_STACK_SIZE=4096
LV_Z_BITS_PER_PIXEL=1
LV_COLOR_DEPTH_1=y
LV_DPI_DEF=145
LV_Z_VDB_SIZE=100
LV_USE_THEME_MONO=y
LV_COLOR_CHROMA_KEY_HEX=0x00FF00
ZMK_LV_FONT_DEFAULT_SMALL_MONTSERRAT_16=y
LV_FONT_MONTSERRAT_26=y
LV_FONT_DEFAULT_MONTSERRAT_26=y

# custom status screens
ZMK_DISPLAY_STATUS_SCREEN_CUSTOM=y
ZMK_DISPLAY_STATUS_SCREEN_BUILT_IN=n
CUSTOM_WIDGET_BATTERY_STATUS=y
ZMK_WIDGET_BATTERY_STATUS=n
CUSTOM_WIDGET_OUTPUT_STATUS=y
ZMK_WIDGET_OUTPUT_STATUS=n
CUSTOM_WIDGET_LAYER_STATUS=y
ZMK_WIDGET_LAYER_STATUS=n

 config I2C
     default y

 config SSD1306
     default y

 endif # ZMK_DISPLAY

 if LVGL

 config LV_Z_VDB_SIZE
     default 64

 config LV_DPI_DEF
     default 148

 config LV_Z_BITS_PER_PIXEL
     default 1

 choice LV_COLOR_DEPTH
     default LV_COLOR_DEPTH_1
 endchoice

 endif # LVGL
endif # SHIELD_SPLIT_LITTLE_60_LEFT || SHIELD_SPLIT_LITTLE_60_LEFTC

if SHIELD_SPLIT_LITTLE_60_RIGHT

config ZMK_KEYBOARD_NAME
    default "Split Little 60"

config ZMK_SPLIT
    default y

config ZMK_BLE
    default y

endif
```

## boards/shields/split_little_60/Kconfig.shield
```kconfig
# Copyright (c) 2024 Lorenzo Pastrana
# SPDX-License-Identifier: MIT

config SHIELD_SPLIT_LITTLE_60_DONGLE
    def_bool $(shields_list_contains,split_little_60_dongle)

config SHIELD_SPLIT_LITTLE_60_LEFT
    def_bool $(shields_list_contains,split_little_60_left)

config SHIELD_SPLIT_LITTLE_60_RIGHT
    def_bool $(shields_list_contains,split_little_60_right)
```
